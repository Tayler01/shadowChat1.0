## firmware/esp-bridge/main/Kconfig.projbuild
```kconfig
menu "ShadowChat Bridge"

config BRIDGE_SUPABASE_URL
    string "Supabase project URL"
    default ""
    help
        Base project URL, for example https://example.supabase.co

config BRIDGE_SUPABASE_ANON_KEY
    string "Supabase anon key"
    default ""
    help
        Anonymous API key used to invoke public bridge Edge Functions.

config BRIDGE_HARDWARE_MODEL
    string "Bridge hardware model"
    default "esp32-s3"

config BRIDGE_FIRMWARE_VERSION
    string "Bridge firmware version"
        default "0.2.6-bootstrap-autodetect"

config BRIDGE_UPDATE_CHANNEL
    string "Bridge update channel"
    default "stable"
    help
        Update manifest channel used for startup and manual firmware checks.
        Expected values are stable, beta, or dev.

config BRIDGE_USB_BOOTSTRAP_MSC
    bool "Expose first-plug bootstrap USB mass-storage drive"
    default y
    help
        Initializes a small FAT partition as a USB MSC bootstrap drive containing
        START.CMD, SETUP.CMD, README.TXT, and a PowerShell bundle receiver.

        This requires an ESP32-S3 board whose exposed USB connector is routed to
        the USB-OTG peripheral. Boards exposing only the fixed USB Serial/JTAG
        path may keep the serial bootstrap commands but will not show the drive.

config BRIDGE_DEVICE_SERIAL
    string "Bridge device serial override"
    default ""
    help
        Optional stable device serial override. Leave blank to derive a serial
        from the ESP MAC address at runtime.

endmenu
```

## firmware/esp-bridge/sdkconfig.defaults
```kconfig
CONFIG_ESP_CONSOLE_USB_SERIAL_JTAG=y
CONFIG_ESP_CONSOLE_SECONDARY_NONE=y
CONFIG_PARTITION_TABLE_CUSTOM=y
CONFIG_PARTITION_TABLE_FILENAME="partitions.csv"
CONFIG_ESPTOOLPY_FLASHSIZE_4MB=y
CONFIG_MBEDTLS_CERTIFICATE_BUNDLE=y
CONFIG_MBEDTLS_CERTIFICATE_BUNDLE_DEFAULT_FULL=y
CONFIG_BRIDGE_FIRMWARE_VERSION="0.2.6-bootstrap-autodetect"
CONFIG_COMPILER_OPTIMIZATION_SIZE=y
CONFIG_BRIDGE_USB_BOOTSTRAP_MSC=y
CONFIG_TINYUSB_DESC_USE_DEFAULT_PID=n
CONFIG_TINYUSB_DESC_CUSTOM_PID=0x4001
CONFIG_TINYUSB_DESC_MANUFACTURER_STRING="ShadowChat"
CONFIG_TINYUSB_DESC_PRODUCT_STRING="ShadowChat Bridge"
CONFIG_TINYUSB_DESC_MSC_STRING="ShadowChat Bootstrap"
CONFIG_TINYUSB_CDC_ENABLED=y
CONFIG_TINYUSB_MSC_ENABLED=y
CONFIG_WL_SECTOR_SIZE_512=y
CONFIG_WL_SECTOR_MODE_PERF=y
```
